## package/logrotate/Config.in
```kconfig
config BR2_PACKAGE_LOGROTATE
	bool "logrotate"
	select BR2_PACKAGE_POPT
	depends on BR2_USE_WCHAR
	help
	  A simple program to rotate logs.

	  /home/lucas/Downloads/

comment "logrotate requires a toolchain with WCHAR support"
	depends on !BR2_USE_WCHAR
```
